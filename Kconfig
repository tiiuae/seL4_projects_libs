## Kconfig
```kconfig
#
# Copyright 2014, NICTA
#
# This software may be distributed and modified according to the terms of
# the BSD 2-Clause license. Note that NO WARRANTY is provided.
# See "LICENSE_BSD2.txt" for details.
#
# @TAG(NICTA_BSD)
#

config LIB_SEL4_ARM_VMM
    bool "VMM library for ARM"
    default y
    depends on LIB_UTILS
    depends on LIB_SEL4_UTILS
    depends on LIB_SEL4_VKA
    depends on LIB_SEL4_VSPACE
    depends on LIB_SEL4_SIMPLE
    depends on LIB_PLATSUPPORT
    depends on LIB_SEL4_VCHAN
    depends on ARM_HYPERVISOR_SUPPORT
    help
        Build a VMM support library for the seL4 hypervisor

config ONDEMAND_DEVICE_INSTALL
    bool "Allow on demand device installation"
    default y
    depends on LIB_SEL4_ARM_VMM
    help
        Allow the VMM to install arbitrary devices into the VM as they are accessed.
```

## libsel4vchan/Kconfig
```kconfig
#
# Copyright 2017, Data61
# Commonwealth Scientific and Industrial Research Organisation (CSIRO)
# ABN 41 687 119 230.
#
# This software may be distributed and modified according to the terms of
# the BSD 2-Clause license. Note that NO WARRANTY is provided.
# See "LICENSE_BSD2.txt" for details.
#
# @TAG(DATA61_BSD)
#
config LIB_SEL4_VCHAN
    bool "vchan connections components & vms"
    default y
    depends on LIB_SEL4 && HAVE_LIBC && LIB_SEL4_VKA && LIB_SEL4_UTILS && \
               LIB_SEL4_VSPACE && LIB_SEL4_SIMPLE && LIB_UTILS
    help
        vchan connections for camkes components and vm's
```
